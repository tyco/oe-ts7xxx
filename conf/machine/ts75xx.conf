## conf/machine/ts75xx.conf
```bitbake
#@TYPE: Machine
#@Name: Technologic Systems TS-75xx SBC
#@DESCRIPTION: Machine configuration for Technologic Systems TS-75xx SBC

TARGET_ARCH = "arm"

PREFERRED_PROVIDER_virtual/kernel = "linux"

MACHINE_FEATURES = "kernel26 ext2 usbhost"

#This requires cavium fa526 patch set to function
#PREFERRED_VERSION_linux = "2.6.24.4"
PREFERRED_PROVIDER_virtual/kernel = "linux"

SERIAL_CONSOLE = "115200 ttyS0"
USE_VT = "0"

# uses the traditional TS-7500 bootloader process 
CMDLINE = "root=/dev/ram0 init=/linuxrc console=none lpj=958464"
#CMDLINE = "console=ttyAM0,115200 ip=192.168.1.3:192.168.1.2:192.168.1.2:255.255.255.0 root=/dev/nfs nfsroot=192.168.1.2:/media/data/devel/oe/ts72xx-stable/tmp/deploy/glibc/images/ts72xx/nfsroot"

require conf/machine/include/tune-fa526.inc
```
